#pragma once
// Independent physical integration across abrupt PWM changes; no steady-state
// reset of the capacitor and no waveform generated by the observer under test.
inline bool testSensingTransitions() {
    StaticJsonDocument<128> doc;uint8_t bank=0;
    for (const char *bad:{"{}","{\"output\":2}","{\"output\":\"AOUT3\"}","{\"output\":\"AOUT1\",\"extra\":true}"}) {
        deserializeJson(doc,bad);if (!protection::parsePolarity(doc.as<JsonObjectConst>(),bank) || bank) return false;
    }
    deserializeJson(doc,"{\"output\":\"AOUT2\"}");
    if (protection::parsePolarity(doc.as<JsonObjectConst>(),bank) || bank!=1) return false;
    const double dt=.001/1024,rg=3000,rt=3000,rp=rg*(3300./238-1),goff=1/rg+1/rp,gon=goff+1/rt;
    uint32_t random=78;
    for (unsigned tau:{120,18688}) for (unsigned positive:{0,1})
    for (unsigned pattern:{0,1,2,3}) for (bool shorted:{false,true}) {
        const double cap=tau*dt*gon;double voltage=2.;
        sensing::Calibration cal;cal.zero=238;cal.tau=tau;cal.positiveBank=positive;
        const double sources[]={positive==0?3.6:1.4,positive==1?3.6:1.4};
        for (unsigned i=0;i<2;++i) for (auto &v:cal.references[i]) v=lround((sources[i]/rt+3.3/rp)/gon*1000);
        sensing::Fit fit;sensing::Model model;
        for (unsigned frame=0;frame<32;++frame) {
            const unsigned ramp[]={500,50,425,100,350,150,275,200};
            unsigned a=500,b=500;
            if (pattern==1) a=b=ramp[frame%8];
            if (pattern==2) {a=ramp[frame%8];b=500-a;}
            if (pattern==3) {a=(frame/4)%2?0:500;b=500-a;}
            model.configure(a,b,tau,cal.ratio());const sensing::Basis basis(cal,a,b);
            sensing::Batch batch;double z=1;unsigned last=0,next=2048;
            for (unsigned tick=0;tick<5120;++tick) {
                unsigned phase=(frame*5120+tick+123)%1024;
                const bool pa=phase<a,pb=phase>=512 && phase<512+b;
                if (tick>=next) {
                    random=random*1664525u+1013904223u;
                    const float noise=(int(random>>16)-32768)*(16.f/65536);
                    float mv=std::max(150.f,float(std::round(voltage*1000))+noise);
                    auto sample=basis.observe(model,phase,mv);
                    if (tau>512) {
                        if (batch.data.count) {z*=double(model.retention[phase])/model.retention[last];if (phase<last) z*=model.retention[1024];}
                        batch.add(sample.a,sample.b,sample.y,z,false,phase);last=phase;
                    } else fit.add(sample.a,sample.b,sample.y,false,phase);
                    next=tick+45+(random%19);
                }
                const double source=pa?(shorted?(positive==0?0:5):sources[0]):pb?(shorted?(positive==1?0:5):sources[1]):0;
                voltage+=dt/cap*(3.3/rp+(pa||pb?source/rt:0)-voltage*(pa||pb?gon:goff));
            }
            if (tau>512) batch.merge(fit);
        }
        const auto result=fit.result();
        if (!result.valid || fit.healthy(result,80)==shorted) {
            std::cerr<<"Transient RC failure tau="<<tau<<" positive="<<positive<<" pattern="<<pattern<<" short="<<shorted
                     <<" valid="<<result.valid<<" gains="<<result.a<<","<<result.b<<" rms="<<result.rms<<" noise="<<result.noise<<"\n";
            return false;
        }
    }
    std::cout<<"PASS: both sensor outputs, slow/fast RC, capacitor memory during brightness/fade/alternate transitions and real circuit short responses\n";
    return true;
}
